/dts-v1/;
/plugin/;
/ {
    fragment@0 {
        target-path = "/fpga-full";
        __overlay__ {
            firmware-name = "kv260-joint-fifo-v1/joint_system.bit.bin";
            resets = <&zynqmp_reset 116>;
        };
    };
};
